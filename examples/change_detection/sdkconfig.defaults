## examples/change_detection/sdkconfig.defaults
```kconfig
#
# Compiler options DEBUG
#
CONFIG_OPTIMIZATION_LEVEL_DEBUG=y
CONFIG_OPTIMIZATION_ASSERTIONS_ENABLED=y
CONFIG_STACK_CHECK_ALL=y
CONFIG_STACK_CHECK=y
CONFIG_WARN_WRITE_STRINGS=y
CONFIG_LOG_DEFAULT_LEVEL_DEBUG=y

#
# ESP32-specific
#
CONFIG_SPIRAM_SUPPORT=y
CONFIG_SPIRAM_IGNORE_NOTFOUND=y
CONFIG_WIFI_LWIP_ALLOCATION_FROM_SPIRAM_FIRST=y
#CONFIG_SPIRAM_TYPE_ESPPSRAM64=y
CONFIG_RTCIO_SUPPORT_RTC_GPIO_DESC=y
#CONFIG_ESP32_SPIRAM_SUPPORT=y
#CONFIG_SPIRAM_TYPE_ESPPSRAM32=y
CONFIG_SPIRAM_TYPE_AUTO=y
#CONFIG_SPIRAM_TYPE_ESPPSRAM32=Auto-detect
#CONFIG_SPIRAM_SIZE=-1
CONFIG_SPIRAM_TYPE=Auto-detect
```
